## AdvancedQuadrocopterFirmware/main/Kconfig.projbuild
```kconfig
menu "Advanced Quadrocopter COnfiguration"
    config SSP_ENABLED
        bool "Secure Simple Pairing"
        depends on BT_CLASSIC_ENABLED
        default y
        help
            This enables the Secure Simple Pairing. If disable this option,
            Bluedroid will only support Legacy Pairing

    config PEER_DEVICE_NAME
        string "Target Device Name"
        default "Barna A34 eszköze"
        help
            Use this option to set target device name to connect.
endmenu
```
